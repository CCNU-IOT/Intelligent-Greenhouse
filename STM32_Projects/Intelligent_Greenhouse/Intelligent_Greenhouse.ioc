# file: Intelligent_Greenhouse.ioc
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Mcu.Family=STM32F1
Mcu.Name=STM32F103Z(C-D-E)Tx
Mcu.Package=LQFP144
NVIC.PriorityGroup=NVIC_PRIORITYGROUP_4
OSC_IN.Mode=HSE-External-Oscillator
OSC_IN.Signal=RCC_OSC_IN
OSC_OUT.Mode=HSE-External-Oscillator
OSC_OUT.Signal=RCC_OSC_OUT
PC14-OSC32_IN.Mode=LSE-External-Oscillator
PC14-OSC32_IN.Signal=RCC_OSC32_IN
PC15-OSC32_OUT.Mode=LSE-External-Oscillator
PC15-OSC32_OUT.Signal=RCC_OSC32_OUT
ProjectManager.HeapSize=0x200
ProjectManager.StackSize=0x400
ProjectManager.TargetToolchain=MDK-ARM V5.32
RCC.AHBFreq_Value=72000000
RCC.APB1CLKDivider=RCC_HCLK_DIV2
RCC.APB1Freq_Value=36000000
RCC.APB1TimFreq_Value=72000000
RCC.APB2Freq_Value=72000000
RCC.APB2TimFreq_Value=72000000
RCC.HCLKFreq_Value=72000000
RCC.PLLMUL=RCC_PLL_MUL9
RCC.PLLSourceVirtual=RCC_PLLSOURCE_HSE
RCC.SYSCLKFreq_VALUE=72000000
RCC.SYSCLKSource=RCC_SYSCLKSOURCE_PLLCLK
RCC.USBFreq_Value=72000000
VP_SYS_VS_ND.Mode=No_Debug
board=custom

// file: Src/main.c
/* USER CODE BEGIN Header */
/**
  ******************************************************************************
  * @file           : main.c
  * @brief          : Main program body
  ******************************************************************************
  * @attention
  *
  * Copyright (c) 2023 STMicroelectronics.
  * All rights reserved.
  *
  * This software is licensed under terms that can be found in the LICENSE file
  * in the root directory of this software component.
  * If no LICENSE file comes with this software, it is provided AS-IS.
  *
  ******************************************************************************
  */
/* USER CODE END Header */
#include "main.h"
#include "gpio.h"

/* USER CODE BEGIN Includes */
#include "../Inc/adc.h"
#include "uart.h"
#include "key.h"
#include "relay.h"
#include "tim.h"
#include "spi.h"
#include "rgb.h"
/* USER CODE END Includes */

void SystemClock_Config(void);

/* USER CODE BEGIN 0 */
    // #define __WS2812__
    // #define __KEY_RELAY__
    // #define __AUTO_RELAY__
    // #define __UART_SENSER__
     #define __NEW_SENSER__
    // #define __PWM__
/* USER CODE END 0 */

int main(void)
{

  /* MCU Configuration--------------------------------------------------------*/

  /* Reset of all peripherals, Initializes the Flash interface and the Systick. */
  HAL_Init();

  /* Configure the system clock */
  SystemClock_Config();

  /* Initialize all configured peripherals */

  /* USER CODE BEGIN 2 */
#ifdef __WS2812__
  /*------------------基于spi实现的ws2812灯带变色-------------------*/
    HAL_SPI_MspInit(&spi_rgb_strip_light_handle);
    spi_rgb_strip_light_init();
  /*------------------基于spi实现的ws2812灯带变色-------------------*/
#endif /*__WS2812__*/

#ifdef __KEY_RELAY__
  /*------------------按键控制水泵-------------------*/
  /*------按下KEY_UP开启水泵，按下其余按钮关闭水泵-----*/
    key_init_it();
    Relay_Init();
  /*------------------按键控制水泵-------------------*/
#endif /*__KEY_RELAY__*/

#ifdef __PWM__
  /*------------------输出PWM波（由PE9输出，可接在示波器上观察）-------------------*/
  // 初始化定时器，设置PWM占空比为50%（可根据需要修改）
    WS2812B_pwm_tim_init(50);
  /*------------------输出PWM波（由PE9输出，可接在示波器上观察）-------------------*/
#endif /*__PWM__*/

#ifdef __NEW_SENSER__
  float humidity; // 土壤湿度值，用于接受ADC数据
  ADC_Init();
#endif /*__NEW_SENSER__*/
  /* USER CODE END 2 */

  /* Infinite loop */
  /* USER CODE BEGIN WHILE */
  while (1)
  {
    MX_GPIO_Init();
    //HAL_Delay(1000);
    /* USER CODE END WHILE */
    /* USER CODE BEGIN 3 */

#ifdef __AUTO_RELAY__
	  // Relay_On();
	  // HAL_Delay(1000);
    // Relay_Off();
    // HAL_Delay(1000);
#endif /*__AUTO_RELAY__*/

#ifdef __UART_SENSER__
    //   // 土壤湿度值
		// if(sensor_read())
		// 	printf("干燥\r\n");
		// else
		// 	printf("潮湿\r\n");

		// humidity = (float)(ADC_getAverage(20,1))*(3.3/4096);// 采集20次，通道1，参考电压为3.3v
		// printf("rain：%.2f\r\n",humidity);
		// Delay_Ms(1000);
#endif /*__UART_SENSER__*/

#ifdef __NEW_SENSER__
humidity = (float)(ADC_getAverage(5))*(3.3/4096); // 读取5次ADC值求平均
printf("rain：%.2f\r\n",humidity);
#endif /*__NEW_SENSER__*/

#ifdef __WS2812__
    spi_rgb_strip_light_display_color(RED);
    HAL_Delay(500);

    spi_rgb_strip_light_display_color(GREEN);
    HAL_Delay(500);

    spi_rgb_strip_light_display_color(BLUE);
    HAL_Delay(500);

    spi_rgb_strip_light_display_color(YELLOW);
    HAL_Delay(500);

    spi_rgb_strip_light_display_color(PURPLE);
    HAL_Delay(500);
#endif /*__WS2812__*/
  }
  /* USER CODE END 3 */
}

void SystemClock_Config(void)
{
  RCC_OscInitTypeDef RCC_OscInitStruct = {0};
  RCC_ClkInitTypeDef RCC_ClkInitStruct = {0};

  /** Initializes the RCC Oscillators according to the specified parameters
  * in the RCC_OscInitTypeDef structure.
  */
  RCC_OscInitStruct.OscillatorType = RCC_OSCILLATORTYPE_HSE;
  RCC_OscInitStruct.HSEState = RCC_HSE_ON;
  RCC_OscInitStruct.HSEPredivValue = RCC_HSE_PREDIV_DIV1;
  RCC_OscInitStruct.HSIState = RCC_HSI_ON;
  RCC_OscInitStruct.PLL.PLLState = RCC_PLL_ON;
  RCC_OscInitStruct.PLL.PLLSource = RCC_PLLSOURCE_HSE;
  RCC_OscInitStruct.PLL.PLLMUL = RCC_PLL_MUL9;
  if (HAL_RCC_OscConfig(&RCC_OscInitStruct) != HAL_OK)
  {
    Error_Handler();
  }

  /** Initializes the CPU, AHB and APB buses clocks
  */
  RCC_ClkInitStruct.ClockType = RCC_CLOCKTYPE_HCLK|RCC_CLOCKTYPE_SYSCLK
                              |RCC_CLOCKTYPE_PCLK1|RCC_CLOCKTYPE_PCLK2;
  RCC_ClkInitStruct.SYSCLKSource = RCC_SYSCLKSOURCE_PLLCLK;
  RCC_ClkInitStruct.AHBCLKDivider = RCC_SYSCLK_DIV1;
  RCC_ClkInitStruct.APB1CLKDivider = RCC_HCLK_DIV2;
  RCC_ClkInitStruct.APB2CLKDivider = RCC_HCLK_DIV1;

  if (HAL_RCC_ClockConfig(&RCC_ClkInitStruct, FLASH_LATENCY_2) != HAL_OK)
  {
    Error_Handler();
  }
}

void Error_Handler(void)
{
  __disable_irq();
  while (1)
  {
  }
}
